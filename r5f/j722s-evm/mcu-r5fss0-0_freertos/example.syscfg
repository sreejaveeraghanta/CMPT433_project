/**
 * @cliArgs --device "J722S_TDA4VEN_TDA4AEN_AM67" --part "Default" --package "AMW" --context "mcu-r5fss0-0" --product "MCU_PLUS_SDK_J722S@10.01.00"
 * @versions {"tool":"1.22.0+3893"}
 */

/**
 * Import the modules used in this configuration.
 */
const ipc         = scripting.addModule("/drivers/ipc/ipc");
const mcspi       = scripting.addModule("/drivers/mcspi/mcspi", {}, false);
const mcspi1      = mcspi.addInstance();
const clock       = scripting.addModule("/kernel/dpl/clock");
const debug_log   = scripting.addModule("/kernel/dpl/debug_log");
const mpu_armv7   = scripting.addModule("/kernel/dpl/mpu_armv7", {}, false);
const mpu_armv71  = mpu_armv7.addInstance();
const mpu_armv72  = mpu_armv7.addInstance();
const mpu_armv73  = mpu_armv7.addInstance();
const mpu_armv74  = mpu_armv7.addInstance();
const mpu_armv75  = mpu_armv7.addInstance();
const mpu_armv76  = mpu_armv7.addInstance();
const mpu_armv77  = mpu_armv7.addInstance();
const mpu_armv78  = mpu_armv7.addInstance();
const mpu_armv79  = mpu_armv7.addInstance();
const mpu_armv710 = mpu_armv7.addInstance();

/**
 * Write custom configuration values to the imported modules.
 */
ipc.vringAllocationPDK = false;
ipc.a53ss0_0           = "notify_rpmsg";

mcspi1.$name                           = "CONFIG_MCSPI0";
mcspi1.trMode                          = "TX_ONLY";
mcspi1.intrEnable                      = "POLLED";
mcspi1.MCU_SPI.CLK.rx                  = false;
mcspi1.MCU_SPI.CLK.$assign             = "MCU_SPI0_CLK";
mcspi1.MCU_SPI.D0.rx                   = false;
mcspi1.MCU_SPI.D0.$assign              = "MCU_SPI0_D0";
mcspi1.MCU_SPI.D1.$assign              = "MCU_SPI0_D1";
mcspi1.mcspiChannel[0].$name           = "CONFIG_MCSPI_CH0";
mcspi1.mcspiChannel[0].bitRate         = 50000000;
mcspi1.mcspiChannel[0].MCU_CSn.rx      = false;
mcspi1.mcspiChannel[0].MCU_CSn.$assign = "MCU_SPI0_CS0";

clock.usecPerTick     = 100;
clock.timerInputClkHz = 50000000;

debug_log.enableLogZoneWarning = false;
debug_log.enableLogZoneError   = false;
debug_log.enableCssLog         = false;

mpu_armv71.size         = 31;
mpu_armv71.attributes   = "Device";
mpu_armv71.allowExecute = false;
mpu_armv71.$name        = "CONFIG_MPU_REGISTER";

mpu_armv72.size       = 15;
mpu_armv72.$name      = "CONFIG_MPU_TCMA";
mpu_armv72.attributes = "NonCached";

mpu_armv73.baseAddr   = 0x41010000;
mpu_armv73.size       = 15;
mpu_armv73.$name      = "CONFIG_MPU_TCMB";
mpu_armv73.attributes = "NonCached";

mpu_armv74.baseAddr = 0x79100000;
mpu_armv74.size     = 19;
mpu_armv74.$name    = "CONFIG_MPU_MCU_MSRAM";

mpu_armv75.baseAddr = 0x80000000;
mpu_armv75.size     = 31;
mpu_armv75.$name    = "CONFIG_MPU_DDR";

mpu_armv76.baseAddr = 0x60000000;
mpu_armv76.size     = 26;
mpu_armv76.$name    = "CONFIG_MPU_FLASH";

mpu_armv77.baseAddr     = 0xA5000000;
mpu_armv77.size         = 24;
mpu_armv77.$name        = "RTOS_IPC_VRING";
mpu_armv77.allowExecute = false;
mpu_armv77.attributes   = "NonCached";

mpu_armv78.$name        = "LINUX_VRING";
mpu_armv78.baseAddr     = 0xA1000000;
mpu_armv78.attributes   = "NonCached";
mpu_armv78.size         = 20;
mpu_armv78.allowExecute = false;

mpu_armv79.attributes   = "NonCached";
mpu_armv79.size         = 20;
mpu_armv79.allowExecute = false;
mpu_armv79.baseAddr     = 0xA1100000;
mpu_armv79.$name        = "RESOURCE_TABLE_AND_TRACE";

mpu_armv710.size       = 20;
mpu_armv710.attributes = "NonCached";
mpu_armv710.baseAddr   = 0xA1100000;
mpu_armv710.$name      = "FRAME_BUFFER";

/**
 * Pinmux solution for unlocked pins/peripherals. This ensures that minor changes to the automatic solver in a future
 * version of the tool will not impact the pinmux you originally saw.  These lines can be completely deleted in order to
 * re-solve from scratch.
 */
mcspi1.MCU_SPI.$suggestSolution = "MCU_SPI0";
